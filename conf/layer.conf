## conf/layer.conf
```bitbake
# We have a conf and classes directory, add to BBPATH
BBPATH .= ":${LAYERDIR}"

# We have recipes-* directories, add to BBFILES
BBFILES += "${LAYERDIR}/recipes-*/*/*.bb \
            ${LAYERDIR}/recipes-*/*/*.bbappend"

BBFILE_COLLECTIONS += "meta-zybo-z7-10"
BBFILE_PATTERN_meta-zybo-z7-10 = "^${LAYERDIR}/"
BBFILE_PRIORITY_meta-zybo-z7-10 = "6"

LAYERDEPENDS_meta-zybo-z7-10 = "core"
LAYERSERIES_COMPAT_meta-zybo-z7-10 = "scarthgap"
```

## conf/machine/zybo-z7-10.conf
```bitbake
#@TYPE: Machine
#@NAME: zybo-z7-10
#@DESCRIPTION: Machine configuration for the zybo-z7-10 boards.

PREFERRED_PROVIDER_virtual/kernel = "linux-xlnx-digilent"

#### Preamble
MACHINEOVERRIDES =. "${@['', 'zybo-z7-10:']['zybo-z7-10' !='${MACHINE}']}"
#### Regular settings follow

# Yocto device-tree variables
YAML_CONSOLE_DEVICE_CONFIG:pn-device-tree ?= "ps7_uart_1"
YAML_MAIN_MEMORY_CONFIG:pn-device-tree ?= "ps7_ddr_0"
DT_PADDING_SIZE:pn-device-tree ?= "0x1000"
DTC_FLAGS:pn-device-tree ?= ""
YAML_DT_BOARD_FLAGS ?= "{BOARD template}"

# Yocto u-boot-xlnx variables
UBOOT_MACHINE ?= "xilinx_zynq_virt_defconfig"

EXTRA_DT_INCLUDE_FILES:append = " system-user.dtsi"

# Yocto FSBL variables
YAML_SERIAL_CONSOLE_STDIN:pn-fsbl-firmware ?= "ps7_uart_1"
YAML_SERIAL_CONSOLE_STDOUT:pn-fsbl-firmware ?= "ps7_uart_1"

# Serial Console Settings
SERIAL_CONSOLES ?= "115200;ttyPS0"
YAML_SERIAL_CONSOLE_BAUDRATE ?= "115200"

# Set DDR Base address for u-boot-xlnx-scr variables
DDR_BASEADDR ?= "0x0"
SKIP_APPEND_BASEADDR ?= "0"

# Yocto KERNEL Variables
UBOOT_ENTRYPOINT  ?= "0x200000"
UBOOT_LOADADDRESS ?= "0x200000"
KERNEL_EXTRA_ARGS += "UIMAGE_LOADADDR=${UBOOT_ENTRYPOINT}"

# Required generic machine inclusion
require conf/machine/zynq-generic.conf

# This is an 'XSCT' based BSP
XILINX_XSCT_VERSION = "2025.2"
XILINX_WITH_ESW = "xsct"

# Add system XSA from this repository (portable path)
HDF_URI = "file://system.xsa"
HDF_URI[sha256sum] = "5a8e5ad86e947f0d6df6fdb458d3435ffbcd4325f33f629a433322125ad6a5ce"

#### No additional settings should be after the Postamble
#### Postamble
PACKAGE_EXTRA_ARCHS:append = "${@['', ' zybo_z7_10']['zybo-z7-10' != '${MACHINE}']}"
```
